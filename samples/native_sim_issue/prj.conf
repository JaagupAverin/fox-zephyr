## prj.conf
```kconfig
# Requirement 1: C++ with full libcpp
CONFIG_CPP=y
CONFIG_STD_CPP2B=y
CONFIG_REQUIRES_FULL_LIBCPP=y

# Requirement 2: CONFIG_SHELL_GETOPT
CONFIG_ZTEST=y
CONFIG_ZTEST_SHELL=y

# Not requirements, just testing around with these to get things compile:
CONFIG_POSIX_API=y
```

## src/main.cpp
```c
#include <stdio.h>
#include <functional>

using MyFunction = std::function<void()>;

void my_function()
{
	printf("Hello from my_function!\n");
}

void run_function(MyFunction fn)
{
	fn();
}

int main(void)
{
	run_function(my_function);
	return 0;
}
```
